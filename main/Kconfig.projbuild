## main/Kconfig.projbuild
```kconfig
menu "Robot PCB 261111"

config ROBOT_SOL_PULSE_MS
    int "LY011E coil pulse duration (ms, 0 disables)"
    range 0 3000
    default 0
    help
        Use a validated duration for the DC 5 V coil. Leave margin for the
        10 ms control period and task scheduling when choosing this value.
        Both timing settings must be nonzero to allow coil actuation.

config ROBOT_SOL_COOLDOWN_MS
    int "LY011E minimum off time (ms, 0 disables)"
    range 0 3600000
    default 0
    help
        Set from the validated coil duty cycle at the configured pulse length.

endmenu
```

## sdkconfig.defaults
```kconfig
# ESP32-S3 robot controller defaults

CONFIG_ESP_CONSOLE_UART=y
CONFIG_ESP_CONSOLE_UART_BAUDRATE=115200
CONFIG_LOG_DEFAULT_LEVEL_INFO=y

CONFIG_IDF_TARGET="esp32s3"
CONFIG_IDF_TARGET_ESP32S3=y

# ESP32-S3-WROOM-1-N16R8
CONFIG_ESPTOOLPY_FLASHSIZE_16MB=y

# Use the repository partition table so the imu_data partition exists.
# CONFIG_PARTITION_TABLE_SINGLE_APP is not set
CONFIG_PARTITION_TABLE_CUSTOM=y
CONFIG_PARTITION_TABLE_CUSTOM_FILENAME="partitions.csv"
CONFIG_PARTITION_TABLE_FILENAME="partitions.csv"
CONFIG_PARTITION_TABLE_OFFSET=0x8000

CONFIG_FREERTOS_UNICORE=n
CONFIG_ESP_TASK_WDT_INIT=y
CONFIG_ESP_SYSTEM_SINGLE_CORE_MODE=n

# Wi-Fi is the only wireless control transport.
CONFIG_ESP_WIFI_ENABLED=y
# CONFIG_BT_ENABLED is not set

CONFIG_BOOTLOADER_LOG_LEVEL=3
CONFIG_ESP_SYSTEM_LOG_LEVEL=3
```
